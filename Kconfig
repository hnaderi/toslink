## Kconfig
```kconfig
menu "Toslink"

    config TOSLINK_MAX_PAYLOAD
        int "Maximum message payload (bytes)"
        range 1 255
        default 16
        help
            Sets the size of toslink_msg_t. Each queued TX message uses about
            this many bytes of RAM. The receiver's value must be at least the
            transmitter's.

endmenu
```

## examples/link_test/main/Kconfig.projbuild
```kconfig
menu "Toslink link test"

    choice TOSLINK_TEST_ROLE
        prompt "Board role"
        default TOSLINK_TEST_ROLE_TX
        help
            Flash one board as transmitter and the other as receiver.

        config TOSLINK_TEST_ROLE_TX
            bool "Transmitter (drives the TOTX module)"
        config TOSLINK_TEST_ROLE_RX
            bool "Receiver (reads the TORX module)"
    endchoice

    config TOSLINK_TEST_GPIO
        int "GPIO wired to the TOTX input / TORX output"
        default 4 if TOSLINK_TEST_ROLE_TX
        default 5

    config TOSLINK_TEST_INVERT
        bool "Invert the signal (inverting level shifter in the path)"
        default n

    config TOSLINK_TEST_SOAK
        bool "Soak test: saturate the link continuously"
        depends on TOSLINK_TEST_ROLE_TX
        default n
        help
            Skips the text lines and pauses, for long error-rate runs.

    config TOSLINK_TEST_BURST_MS
        int "Bandwidth burst length (ms)"
        depends on TOSLINK_TEST_ROLE_TX && !TOSLINK_TEST_SOAK
        default 5000

endmenu
```

## main/Kconfig.projbuild
```kconfig
menu "Toslink demo"

    choice TOSLINK_DEMO_ROLE
        prompt "Board role"
        default TOSLINK_DEMO_ROLE_TX
        help
            Flash one board as transmitter and the other as receiver.

        config TOSLINK_DEMO_ROLE_TX
            bool "Transmitter (drives the TOTX module)"
        config TOSLINK_DEMO_ROLE_RX
            bool "Receiver (reads the TORX module)"
    endchoice

    config TOSLINK_DEMO_TX_GPIO
        int "GPIO wired to the TOTX input"
        depends on TOSLINK_DEMO_ROLE_TX
        default 4

    config TOSLINK_DEMO_TX_INVERT
        bool "Invert TX pin (active-low, for an inverting level shifter)"
        depends on TOSLINK_DEMO_ROLE_TX
        default n

    config TOSLINK_DEMO_RX_GPIO
        int "GPIO wired to the TORX output"
        depends on TOSLINK_DEMO_ROLE_RX
        default 5

    config TOSLINK_DEMO_RX_INVERT
        bool "Invert RX pin (signal passes through an inverting buffer)"
        depends on TOSLINK_DEMO_ROLE_RX
        default n

    config TOSLINK_DEMO_SEND_PERIOD_MS
        int "Interval between demo commands (ms)"
        depends on TOSLINK_DEMO_ROLE_TX
        default 500

    config TOSLINK_DEMO_REPEATS
        int "Copies sent of each command"
        depends on TOSLINK_DEMO_ROLE_TX
        range 1 10
        default 3

endmenu
```

## sdkconfig.defaults.esp32s2
```kconfig
CONFIG_ESP_CONSOLE_USB_CDC=y
CONFIG_TOSLINK_DEMO_ROLE_TX=y
CONFIG_TOSLINK_DEMO_TX_GPIO=4
```
